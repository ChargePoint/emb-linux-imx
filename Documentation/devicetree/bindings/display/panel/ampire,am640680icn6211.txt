## Documentation/devicetree/bindings/display/panel/ampire,am640680icn6211.txt
```
Ampire 5.5" 640x480 Panel w/ICN6211 DSI->RGB Bridge
===================================================
This panel is a fixed-mode configuration for the
following topology:

    MIPI-DSI ==> ICN6211 ==> RGB LCD Panel
         I2C ==> Bridge

Note that the i2c configuration interface is the
only tested path; using the MIPI-DSI genereric command
interface has not been shown to work on the target
platform.

Required properties:
- compatible: "ampire,am640480-icn6211"

Optional properties:
- label: a symbolic name for the panel
- enable-gpios: panel/bridge enable
- i2c-dev: client for configuring via I2C bus

Required nodes:
- power-supply: regulator for powering panel/bridge
- Video port for DSI input

Example
-------
dsi {
	lcd_panel: panel@0 {
		compatible = "ampire,am640480-icn6211";
		status = "okay";
		reg = <0>;
		pinctrl-0 = <&...>;
		enable-gpios = <&gpio1 7 GPIO_ACTIVE_HIGH>;
		power-supply = <&reg_lcd_power>;
		i2c-dev = <&icn6211_i2c>;
		dsi-lanes = <4>;
		video-mode = <2>;
		panel-width-mm = <117>;
		panel-height-mm = <92>;
		port@0 {
			dsim_from_lcdif: endpoint {
				remote-endpoint: <&lcdif_to_dsim>;
			};
		};
	};
};

&i2c {
	icn_6211_i2c: icn6211@2c {
		compatible = "simple-bus";
		reg = <0x2c>;
	};
};
```

## Documentation/devicetree/bindings/sound/imx-audio-wm8974.txt
```
Freescale i.MX audio complex with WM8974 codec

Required properties:

  - compatible		: "fsl,imx-audio-wm8974"

  - model		: The user-visible name of this sound complex

  - ssi-controller	: The phandle of the i.MX SSI controller

  - audio-codec		: The phandle of the wm8974 audio codec

  - audio-routing	: A list of the connections between audio components.
			  Each entry is a pair of strings, the first being the
			  connection's sink, the second being the connection's
			  source. Valid names could be power supplies, wm8974
			  pins, and the jacks on the board:

			  Power supplies:
			   * Mic Bias

			  Board connectors:
			   * Mic Jack
			   * Line In Jack
			   * Headphone Jack
			   * Line Out Jack
			   * Ext Spk

  - mux-int-port	: The internal port of the i.MX audio muxer (AUDMUX)

  - mux-ext-port	: The external port of the i.MX audio muxer

Note: The AUDMUX port numbering should start at 1, which is consistent with
hardware manual.

Example:

/* i.MX6q connection with ssi1 */
sound {
	compatible = "fsl,imx6q-sabresd-wm8974",
	"fsl,imx-audio-wm8974";
	model = "wm8974-audio";
	cpu-dai = <&ssi1>;
	audio-codec = <&codec>;
	audio-routing =
		"Ext Spk", "MONOOUT",
		"Mic Jack", "Mic Bias",
		"Headphone Jack", "MONOOUT";
	mux-int-port = <1>;
	mux-ext-port = <4>;
	status = "okay";
};

/* i.MX8x connections with sai0 */
sound {
	compatible = "fsl,imx-audio-wm8974";
	model = "wm8974-audio";
	cpu-dai = <&sai0>;
	audio-codec = <&wm8974>;
	audio-routing =
		"Ext Spk", "MONOOUT",
		"Mic", "Mic Bias",
		"MICP", "Mic";
};
```
