## drivers/net/ethernet/chargepoint/Kconfig
```kconfig
# SPDX-License-Identifier: GPL-2.0-only
#
# ChargePoint network device configuration
#

config NET_VENDOR_CHARGEPOINT
	bool "ChargePoint ethernet devices"
	default y
	help
	  If you have a network (Ethernet) card belonging to this class, say Y.

	  Note that the answer to this question doesn't directly affect the
	  kernel: saying N will just cause the configurator to skip all
	  the questions about Qualcomm cards. If you say Y, you will be asked
	  for your specific card in the following questions.

if NET_VENDOR_CHARGEPOINT

config ETH_SPI
	tristate "Ethernet over SPI based on Qualcomm Atheros QCA7000"
	depends on SPI_MASTER && OF
	help
	  This SPI protocol driver supports ethernet over spi for ChargePoint devices.

	  To compile this driver as a module, choose M here. The module
	  will be called eth-spi.

config CHPT_ETH_SPI
	tristate "ChargePoint Eth SPI support"
	depends on SPI_MASTER && OF

config CHPT_ETH_SPI_DEBUG
	bool "ChargePoint Eth SPI debug logging"
	depends on CHPT_ETH_SPI

config CHPT_ETH_SPI_VERBOSE
	bool "ChargePoint Eth SPI verbose debug logging"
	depends on CHPT_ETH_SPI_DEBUG

endif # NET_VENDOR_CHARGEPOINT
```

## drivers/net/wireless/laird/Kconfig
```kconfig
config WLAN_VENDOR_LAIRD
	bool "Laird Connectivity WLAN devices"
	default y
	help
	  If you have a wireless card belonging to this class, say Y.

	  Note that the answer to this question doesn't directly affect the
	  kernel: saying N will just cause the configurator to skip all
	  the questions about cards. If you say Y, you will be asked for
	  your specific card in the following questions.

if WLAN_VENDOR_LAIRD

config LRDMWL
	tristate "60 Series driver (mac80211 compatible)"
	depends on MAC80211
	help
		Select to build the driver supporting the:

		Laird Connectivity 60 Series Wi-Fi module

		This driver uses the kernel's mac80211 subsystem.

		If you want to compile the driver as a module (= code which can be
		inserted in and removed from the running kernel whenever you want),
		say M here and read <file:Documentation/kbuild/modules.txt>.  The
		module will be called lrdmwl.

if LRDMWL

config LRDMWL_PCIE
	tristate "PCIe Bus"
	depends on PCI
	depends on FW_LOADER
	help
		Select to build the driver supporting the:

		Laird Connectivity 60 Series Wi-Fi module for PCIE

		This driver uses the kernel's mac80211 subsystem.

		If you want to compile the driver as a module (= code which can be
		inserted in and removed from the running kernel whenever you want),
		say M here and read <file:Documentation/kbuild/modules.txt>.  The
		module will be called lrdmwl_pcie.

config LRDMWL_SDIO
	tristate "SDIO Bus"
	depends on MMC
	depends on FW_LOADER
	help
		Select to build the driver supporting the:

		Laird Connectivity 60 Series Wi-Fi module for SDIO

		This driver uses the kernel's mac80211 subsystem.

		If you want to compile the driver as a module (= code which can be
		inserted in and removed from the running kernel whenever you want),
		say M here and read <file:Documentation/kbuild/modules.txt>.  The
		module will be called lrdmwl_sdio.

config LRDMWL_USB
	tristate "USB Bus"
	depends on USB
	depends on FW_LOADER
	help
		Select to build the driver supporting the:

		Laird Connectivity 60 Series Wi-Fi module for USB

		This driver uses the kernel's mac80211 subsystem.

		If you want to compile the driver as a module (= code which can be
		inserted in and removed from the running kernel whenever you want),
		say M here and read <file:Documentation/kbuild/modules.txt>.  The
		module will be called lrdmwl_usb.

config LRDMWL_FIPS
	bool "FIPS support for 60 Series based SOMs"
	help
		Enables FIPS operation for SOM60

endif # LRDMWL

endif # WLAN_VENDOR_LAIRD
```

## drivers/net/wireless/laird/lrdmwl/Kconfig
```kconfig
config LRDMWL
	tristate "Laird Connectivity wireless support based on Marvell 8997 chipset (mac80211 compatible)"
	depends on MAC80211
	help
		Select to build the driver supporting the:

		Laird Connectivity 60 Series Wi-Fi module

		This driver uses the kernel's mac80211 subsystem.

		If you want to compile the driver as a module (= code which can be
		inserted in and removed from the running kernel whenever you want),
		say M here and read <file:Documentation/kbuild/modules.txt>.  The
		module will be called lrdmwl.

config LRDMWL_PCIE
	tristate "Laird wireless support based on Marvell chipsets for PCIE"
	depends on LRDMWL && PCI
	select FW_LOADER
	help
		Select to build the driver supporting the:

		Laird Connectivity 60 Series Wi-Fi module for PCIE

		This driver uses the kernel's mac80211 subsystem.

		If you want to compile the driver as a module (= code which can be
		inserted in and removed from the running kernel whenever you want),
		say M here and read <file:Documentation/kbuild/modules.txt>.  The
		module will be called lrdmwl_pcie.

config LRDMWL_SDIO
	tristate "Laird wireless support based on Marvell chipsets for SDIO"
	depends on LRDMWL && MMC
	select FW_LOADER
	help
		Select to build the driver supporting the:

		Laird Connectivity 60 Series Wi-Fi module for SDIO

		This driver uses the kernel's mac80211 subsystem.

		If you want to compile the driver as a module (= code which can be
		inserted in and removed from the running kernel whenever you want),
		say M here and read <file:Documentation/kbuild/modules.txt>.  The
		module will be called lrdmwl_sdio.

config LRDMWL_USB
	tristate "Laird wireless support based on Marvell chipsets for USB"
	depends on LRDMWL
	select FW_LOADER
	help
		Select to build the driver supporting the:

		Laird Connectivity 60 Series Wi-Fi module for USB

		This driver uses the kernel's mac80211 subsystem.

		If you want to compile the driver as a module (= code which can be
		inserted in and removed from the running kernel whenever you want),
		say M here and read <file:Documentation/kbuild/modules.txt>.  The
		module will be called lrdmwl_usb.

config LRDMWL_FIPS
	bool "Laird wireless FIPS support for SOM60"
	depends on LRDMWL
	help
		Enables FIPS operation for SOM60
```
